## ali-smartliving-device-sdk-c/src/protocol/mqtt/Config.in
```kconfig
config MQTT_COMM_ENABLED
    bool "FEATURE_MQTT_COMM_ENABLED"
    default y
    help
        Establish persistent connection with AliCloud via MQTT-based protocol

        Switching to "y" leads to building MQTT related implementation into SDK and MQTT_COMM_ENABLED included into CFLAGS
        Switching to "n" seldom happens unless you're connecting to AliCloud via CoAP/HTTP channel

menu "MQTT Configurations"
    depends on MQTT_COMM_ENABLED

    config MQTT_DIRECT
        bool "FEATURE_MQTT_DIRECT"
        default y
        help
            Directly connect MQTT server without perform HTTP authenticate to another HTTP server ahead

            Switching to "y" leads to connect MQTT server directly and MQTT_DIRECT included into CFLAGS
            Switching to "n" leads to legacy authenticate mode: connnect HTTP server first, then connect MQTT server afterwards
    config MQTT_AUTO_SUBSCRIBE
	bool "FEATURE_MQTT_AUTO_SUBSCRIBE"
	default y
	help
	    Enable the cloud smart subscribe function,save a lot of time and cloud communications.

    config MQTT_SHADOW
        bool "FEATURE_MQTT_SHADOW"
        default n
        help
            Enable providing cache data of IoT device at cloud via "IOT_Shadow_XXX" APIs declared in include/exports/iot_export_shadow.h

    config MQTT_LOGPOST
        bool "FEATURE_MQTT_LOGPOST"
        default n
        help
            Enable capability of publishing important device running log messages to IoT cloud

    config MQTT_PREAUTH_SUPPORT_HTTPS_CDN
	bool "FEATURE_PREAUTH_HTTPS_CDN"
	default y
	help
	    Enable global center https cdn accelerate.
endmenu
```

## ali-smartliving-device-sdk-c/src/services/linkkit/Config.in
```kconfig
config DEVICE_MODEL_ENABLED
    bool "FEATURE_DEVICE_MODEL_ENABLED"
    default y
    help
        Enable providing Thing-Model-Management/Alink-Protocol encapulation in SDK

        Switching to "y" leads to SDK being able to interpret JSON payload in MQTT channel, which also called "Advanced Version Protocol"
        Those capabilities are provided via IOT_Linkkit_XXX() APIs or being_deprecated linkkit_xxx() + linkkit_gateway_xxx() APIs

menu "Device Model Configurations"
    depends on DEVICE_MODEL_ENABLED

    config DM_UNIFIED_SERVICE_POST
        bool "FEATURE_DM_UNIFIED_SERVICE_POST"
        default y
        help
            Switching Thing-Model support topic _thing/service/post

    config DEVICE_MODEL_GATEWAY
        bool "FEATURE_DEVICE_MODEL_GATEWAY"
        depends on (DM_UNIFIED_SERVICE_POST)
        default n
        help
            Switching Thing-Model related implementations provided in gateway oriented way

    config ALCS_ENABLED
        bool "FEATURE_ALCS_ENABLED"
        depends on (DEVICE_MODEL_ENABLED)
        default n
        help
            ALCS(Alibaba Local Communication Service) enable customers communicate with IoT devices from cellphone without Internet

    # FEATURE_ALCS_CLIENT_ENABLED
    # FEATURE_ALCS_SERVER_ENABLED
    source "$SRCPATH/src/protocol/alcs/Config.in"

    config DEV_BIND_ENABLED
        bool "FEATURE_DEV_BIND_ENABLED"
        depends on MQTT_COMM_ENABLED
        default y
        help
            Enable customers to bind device to current user

    config CLOUD_OFFLINE_RESET
        bool "FEATURE_CLOUD_OFFLINE_RESET"
        depends on MQTT_SHADOW
        default n
        help
            Enable cloud offline reset method support.

    config DEVICE_MODEL_RAWDATA_SOLO
        bool "FEATURE_DEVICE_MODEL_RAWDATA_SOLO"
        depends on DEVICE_MODEL_ENABLED && !DEVICE_MODEL_GATEWAY
        default n
        help
            Enable only raw data function via IOT_Linkkit_xxx new APIs

            Switching to "y" leads to SDK being compiled only raw data function
            Switching to "n" leads to SDK being compiled both raw data and thing model function
endmenu
```
